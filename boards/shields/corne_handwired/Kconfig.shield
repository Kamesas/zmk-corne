## boards/shields/corne_handwired/Kconfig.shield
```kconfig
config SHIELD_CORNE_HANDWIRED_LEFT
    def_bool $(shields_list_contains,corne_handwired_left)

config SHIELD_CORNE_HANDWIRED_RIGHT
    def_bool $(shields_list_contains,corne_handwired_right)
```

## config/boards/shields/corne_handwired/Kconfig.defconfig
```kconfig
if SHIELD_CORNE_HANDWIRED_LEFT

config ZMK_KEYBOARD_NAME
    default "Corne Handwired"

config ZMK_SPLIT_ROLE_CENTRAL
    default y

endif

if SHIELD_CORNE_HANDWIRED_LEFT || SHIELD_CORNE_HANDWIRED_RIGHT

config ZMK_SPLIT
    default y

endif
```
